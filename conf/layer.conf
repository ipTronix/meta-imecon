## conf/layer.conf
```bitbake
# We have a conf and classes directory, add to BBPATH
BBPATH .= ":${LAYERDIR}"

# We have a packages directory, add to BBFILES
BBFILES += "${LAYERDIR}/recipes-*/*/*.bb \
            ${LAYERDIR}/recipes-*/*/*.bbappend"

BBFILE_COLLECTIONS += "imeconVKY"
BBFILE_PATTERN_imeconVKY := "^${LAYERDIR}/"
BBFILE_PRIORITY_imeconVKY = "10"

LAYERDEPENDS_imeconVKY = "fsl-arm fsl-arm-extra"

PREFERRED_PROVIDER_wpa-supplicant = "wpa-supplicant-wl18xx"
PREFERRED_PROVIDER_wpa-supplicant-passphrase = "wpa-supplicant-wl18xx"
PREFERRED_PROVIDER_wpa-supplicant-cli = "wpa-supplicant-wl18xx"
```

## conf/machine/imeconVKY.conf
```bitbake
#@TYPE: Machine
#@NAME: imeconVKY
#@SOC: i.MX6
#@DESCRIPTION: Machine configuration for Imecon VKY
#@MAINTAINER: Dario Pennisi <dario@iptronix.com>

require conf/machine/include/imx-base.inc
require conf/machine/include/tune-cortexa9.inc

SOC_FAMILY = "mx6:mx6q"

PREFERRED_PROVIDER_virtual/kernel = "linux-imx"
PREFERRED_VERSION_linux-imx = "3.14.52"
KERNEL_DEVICETREE = "imx6q-imeconVKY.dtb"
KERNEL_IMAGETYPE = "zImage"

PREFERRED_PROVIDER_u-boot = "u-boot-boundary"

# Use SPI NOR U-Boot by default
IMAGE_BOOTLOADER ?= ""

# Ensure boot scripts will be available at rootfs time
do_rootfs[depends] += "u-boot-script-boundary:do_deploy"

# Boot scripts to install
BOOT_SCRIPTS = "6x_bootscript-${MACHINE}:6x_bootscript"

UBOOT_MACHINE ?= "imeconVKY_defconfig"

SERIAL_CONSOLE = "115200 ttymxc1"

MACHINE_EXTRA_RRECOMMENDS += "linux-firmware-wl12xx"

MACHINE_FEATURES += " pci wifi bluetooth"
```
